## board/novasom/Kconfig
```kconfig
if TARGET_NOVASOM

config SYS_CPU
	default "armv7"

config SYS_BOARD
	default "novasom"

config SYS_SOC
	default "mx6"

config SYS_CONFIG_NAME
	default "novasom"

endif
```
